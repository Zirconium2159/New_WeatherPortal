#define INTERVAL_SENSOR   10     //定义传感器采样时间间隔  597000
#define INTERVAL_NET      1000           //定义发送时间
//传感器部分================================   
#include <Wire.h>                                  //调用库  
#include "./ESP8266.h"
#include "I2Cdev.h"                                //调用库  
//温湿度   

#include "Wire.h"

#include <SHT2x.h>
//光照

#include "U8glib.h"
//-------字体设置，大、中、小
#define setFont_L u8g.setFont(u8g_font_7x13)
#define setFont_M u8g.setFont(u8g_font_fixed_v0r)
#define setFont_S u8g.setFont(u8g_font_fixed_v0r)

#define setFont_SS u8g.setFont(u8g_font_fub25n)
/*
font:
 u8g_font_7x13
 u8g_font_fixed_v0r
 u8g_font_chikitar
 u8g_font_osb21
 u8g_font_courB14r
 u8g_font_courB24n
 u8g_font_9x18Br
 */
//屏幕类型--------
U8GLIB_SSD1306_128X64 u8g(U8G_I2C_OPT_NONE);

#define init_draw 5  //主界面刷新时间

unsigned long timer_draw,timer;
int pkj=0;
String dateStr, ret;

#define  sensorPin_1  A0

#define SSID           "jijiwaiwai"                   // cannot be longer than 32 characters!
#define PASSWORD       "bupt.edu.cnn"
// Security can be WLAN_SEC_UNSEC, WLAN_SEC_WEP, WLAN_SEC_WPA or WLAN_SEC_WPA2
#define WLAN_SECURITY   WLAN_SEC_WPA2

#define IDLE_TIMEOUT_MS  3000      // Amount of time to wait (in milliseconds) with no data 
                                   // received before closing the connection.  If you know the server
                                   // you're accessing is quick to respond, you can reduce this value.

//WEBSITE     
#define HOST_NAME    "139.199.29.58"             //可改成自己的服务器地址和端口
#define HOST_PORT   (80)

//3,传感器值的设置 
float sensor_tem, sensor_hum, sensor_lux;                    //传感器温度、湿度、光照   
char  sensor_tem_c[7], sensor_hum_c[7], sensor_lux_c[7] ;    //换成char数组传输
#include <SoftwareSerial.h>
SoftwareSerial mySerial(2, 3); /* RX:D3, TX:D2 */
ESP8266 wifi(mySerial);
//ESP8266 wifi(Serial1);                                      //定义一个ESP8266（wifi）的对象
unsigned long net_time1 = millis();                          //数据上传服务器时间
unsigned long sensor_time = millis();                        //传感器采样时间计时器

//int SensorData;                                   //用于存储传感器数据
String postString;                                //用于存储发送数据的字符串
//String jsonToSend;                                //用于存储发送的json格式参数
int x,y,time,i;

//============这里只是显示屏的代码，感兴趣的接个显示屏看看，不然就注释掉好了=============================//


static unsigned char u8g_logo_bits0[] U8G_PROGMEM =

{0x00,0x00,0x00,0x00,0x00,0x00,0x00,0x00,0x00,0x00,0x00,0x00,0x00,0x00,0x00,0x78,
0x00,0x00,0x00,0x00,0x00,0x7E,0x00,0x00,0x00,0x00,0x00,0x7F,0x00,0x00,0x00,0x00,
0x80,0x3F,0x00,0x00,0x00,0x00,0x80,0x3F,0x00,0x00,0x00,0x00,0xC0,0x1F,0x00,0x00,
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0x00,0x00,0x00,0x00,0x00,0x00,0x00,0x00,0x00,0x00,0x00,0x00,0x00,0x00,0x00,0x00};
static unsigned char u8g_logo_bits1[] U8G_PROGMEM =

{0x00,0x00,0xC4,0x1F,0x48,0x10,0x48,0x10,0xC1,0x1F,0x42,0x10,0x42,0x10,0xC8,0x1F,
0x08,0x00,0xE4,0x3F,0x27,0x25,0x24,0x25,0x24,0x25,0x24,0x25,0xF4,0x7F,0x00,0x00};//wen
static unsigned char u8g_logo_bits5[] U8G_PROGMEM =

{0x80,0x00,0x00,0x01,0xFC,0x7F,0x44,0x04,0x44,0x04,0xFC,0x3F,0x44,0x04,0x44,0x04,
0xC4,0x07,0x04,0x00,0xF4,0x0F,0x24,0x08,0x42,0x04,0x82,0x03,0x61,0x0C,0x1C,0x70};//du

static unsigned char u8g_logo_bits2[] U8G_PROGMEM =
{

0x00,0x00,0xE4,0x1F,0x28,0x10,0x28,0x10,0xE1,0x1F,0x22,0x10,0x22,0x10,0xE8,0x1F,
0x88,0x04,0x84,0x04,0x97,0x24,0xA4,0x14,0xC4,0x0C,0x84,0x04,0xF4,0x7F,0x00,0x00
};//shi


static unsigned char u8g_logo_bits3[] U8G_PROGMEM =
{0x80,0x00,0x84,0x10,0x88,0x10,0x90,0x08,0x90,0x04,0x80,0x00,0xFF,0x7F,0x20,0x02,
0x20,0x02,0x20,0x02,0x20,0x02,0x10,0x42,0x10,0x42,0x08,0x42,0x04,0x7C,0x03,0x00};//guang

static unsigned char u8g_logo_bits4[] U8G_PROGMEM =
{0x00,0x00,0xBE,0x3F,0x22,0x22,0x22,0x22,0x22,0x22,0x22,0x29,0xBE,0x10,0x22,0x3F,
0x22,0x21,0x22,0x21,0x22,0x21,0x3E,0x3F,0x00,0x00,0x12,0x11,0x22,0x22,0x21,0x22};//zhao

//-------==============================================------------//


void setup(void)     //初始化函数  
{       
  //初始化串口波特率  
    Wire.begin();
    Serial.begin(115200);   
    while(!Serial);
    pinMode(sensorPin_1, INPUT);

   //ESP8266初始化
    Serial.print("setup begin\r\n");   

  Serial.print("FW Version:");
  Serial.println(wifi.getVersion().c_str());

  if (wifi.setOprToStationSoftAP()) {
    Serial.print("to station + softap ok\r\n");
  } else {
    Serial.print("to station + softap err\r\n");
  }

  if (wifi.joinAP(SSID, PASSWORD)) {      //加入无线网
    Serial.print("Join AP success\r\n");  
    Serial.print("IP: ");
    Serial.println(wifi.getLocalIP().c_str());
  } else {
    Serial.print("Join AP failure\r\n");
  }

  if (wifi.disableMUX()) {
    Serial.print("single ok\r\n");
  } else {
    Serial.print("single err\r\n");
  }

  Serial.print("setup end\r\n");

  
}
void loop(void)     //循环函数  
{   
  time=millis()/1000;
  if (sensor_time > millis())  sensor_time = millis();  
    
  if(millis() - sensor_time > INTERVAL_SENSOR)              //传感器采样时间间隔  
  {  
    getSensorData();                                        //读串口中的传感器数据
    sensor_time = millis();
  }  
   if (millis() - timer_draw > init_draw)
  {
    pkj-=4;
    u8g.firstPage();
    do {
      draw();
    }
    while ( u8g.nextPage() );
    timer_draw = millis();
  }
    
  if (net_time1 > millis())  net_time1 = millis();
  
  if (millis() - net_time1 > INTERVAL_NET)                  //发送数据时间间隔
  {                
    updateSensorData();    //将数据上传到服务器的函数
   
  }

}

void getSensorData(){  
    sensor_tem = SHT2x.GetTemperature() ;   
    sensor_hum = SHT2x.GetHumidity();   
    //获取光照
    sensor_lux = analogRead(A0);    
    delay(1000);
    dtostrf(sensor_tem, 2, 1, sensor_tem_c);
    dtostrf(sensor_hum, 2, 1, sensor_hum_c);
    dtostrf(sensor_lux, 3, 1, sensor_lux_c);
}
void updateSensorData() {
  if (wifi.createTCP(HOST_NAME, HOST_PORT)) { //建立TCP连接，如果失败，不能发送该数据
    Serial.print("create tcp ok\r\n");
 

//postString将存储传输请求，格式很重要
postString = "GET ";               //post发送方式，后要有空格
  postString += "/istation/hh.php?tem=";    //接口process
  postString += sensor_tem_c;
  postString += "&hum=";             //要发送的数据
  postString += sensor_hum_c;
  postString += "&lux=";            
  postString += sensor_lux_c;
  postString += " HTTP/1.1";          //空格+传输协议
  postString += "\r\n";
  postString += "Host: ";            //Host：+空格
  postString += HOST_NAME;
  postString += "\r\n";
  postString += "Content-Type: application/x-www-form-urlencoded\r\n";  //编码类型
  postString += "Connection: close\r\n";
  postString += "\r\n";               //不可删除

  const char *postArray = postString.c_str();                 //将str转化为char数组
  Serial.println(postArray);
  wifi.send((const uint8_t*)postArray, strlen(postArray));    //send发送命令，参数必须是这两种格式，尤其是(const uint8_t*)
  Serial.println("send success");   
     if (wifi.releaseTCP()) {                                 //释放TCP连接
        Serial.print("release tcp ok\r\n");
        } 
     else {
        Serial.print("release tcp err\r\n");
        }
      postArray = NULL;                                       //清空数组，等待下次传输数据
  
  } else {
    Serial.print("create tcp err\r\n");
  }
  
}
void draw()
{
  setFont_L;
  u8g.drawXBMP( 0, 0, 16, 16, u8g_logo_bits1);
  u8g.drawXBMP( 20, 0, 16, 16, u8g_logo_bits5);
  u8g.setPrintPos(50,15);
  u8g.print(sensor_tem);
  

  u8g.drawXBMP( 0, 20, 16, 16, u8g_logo_bits2);
  u8g.drawXBMP( 20, 20, 16, 16, u8g_logo_bits5);
  u8g.setPrintPos(50,35);
  u8g.print(sensor_hum);
  
  u8g.drawXBMP( 0, 40, 16, 16, u8g_logo_bits3);
  u8g.drawXBMP( 20, 40, 16, 16, u8g_logo_bits4);
  u8g.setPrintPos(50,55);
  u8g.print(sensor_lux);
  
  u8g.drawXBMP( 90, 0, 48, 48, u8g_logo_bits0);
}
